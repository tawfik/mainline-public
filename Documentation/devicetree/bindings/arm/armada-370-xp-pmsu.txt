## Documentation/devicetree/bindings/arm/armada-370-xp-pmsu.txt
```
Power Management Service Unit(PMSU)
-----------------------------------
Available on Marvell SOCs: Armada 370 and Armada XP

Required properties:

- compatible: "marvell,armada-370-xp-pmsu"

- reg: Should contain PMSU registers location and length. First pair
  for the per-CPU SW Reset Control registers, second pair for the CPU
  Power Management Service Unit registers, third pair for the Fabric Power
  Management Service Unit registers.

Example:

armada-370-xp-pmsu@22000 {
	compatible = "marvell,armada-370-xp-pmsu";
	reg = <0x22100 0x430>,
	      <0x20800 0x20>,
	      <0x22000 0x24>;
};
```

## Documentation/devicetree/bindings/arm/armada-38x.txt
```
Marvell Armada 38x Platforms Device Tree Bindings
-------------------------------------------------

Boards with a SoC of the Marvell Armada 38x family shall have the
following property:

Required root node property:

compatible: must contain "marvell,armada38x"

In addition, boards using the Marvell Armada 380 SoC shall have the
following property:

Required root node property:

compatible: must contain "marvell,armada380"

In addition, boards using the Marvell Armada 385 SoC shall have the
following property:

Required root node property:

compatible: must contain "marvell,armada385"
```

## Documentation/devicetree/bindings/arm/armada-cpu-reset.txt
```
Marvell Armada CPU reset controller
===================================

Required properties:

- compatible: Should be "marvell,armada-<chip>-cpu-reset". Supported
  values are:
    marvell,armada-370-cpu-reset
    marvell,armada-xp-cpu-reset

- reg: should be register base and length as documented in the
  datasheet for the CPU reset registers

cpurst: cpurst@20800 {
       compatible = "marvell,armada-xp-cpu-reset";
       reg = <0x20800 0x20>;
};
```

## Documentation/devicetree/bindings/cpufreq/cpufreq-cpu0.txt
```
Generic cpufreq driver

It is a generic cpufreq driver for frequency management.  It
supports both uniprocessor (UP) and symmetric multiprocessor (SMP)
systems which may or maynot share clock and voltage across all CPUs.

Both required and optional properties listed below must be defined
under node /cpus/cpu@x. Where x is the first cpu inside a cluster.

Required properties:
- None

Optional properties:
- operating-points: Refer to Documentation/devicetree/bindings/power/opp.txt for
  details. OPPs *must* be supplied either via DT, i.e. this property, or
  populated at runtime.
- clock-latency: Specify the possible maximum transition latency for clock,
  in unit of nanoseconds.
- voltage-tolerance: Specify the CPU voltage tolerance in percentage.
- #cooling-cells:
- cooling-min-level:
- cooling-max-level:
     Please refer to Documentation/devicetree/bindings/thermal/thermal.txt.
- clocks: If CPU clock is populated from DT, "clocks" property must be copied to
  every cpu node sharing clock with cpu@x. Generic cpufreq driver compares
  "clocks" to find siblings, i.e. to see which CPUs share clock/voltages. If
  only cpu@0 contains "clocks" property it is assumed that all CPUs share clock
  line.

Examples:

1. All CPUs share clock/voltages

cpus {
	#address-cells = <1>;
	#size-cells = <0>;

	cpu@0 {
		compatible = "arm,cortex-a9";
		reg = <0>;
		next-level-cache = <&L2>;
		operating-points = <
			/* kHz    uV */
			792000  1100000
			396000  950000
			198000  850000
		>;
		clocks = <&clock CLK_ARM_CLK>;
		clock-names = "cpu";
		clock-latency = <61036>; /* two CLK32 periods */
		#cooling-cells = <2>;
		cooling-min-level = <0>;
		cooling-max-level = <2>;
	};

	cpu@1 {
		compatible = "arm,cortex-a9";
		reg = <1>;
		next-level-cache = <&L2>;
		clocks = <&clock CLK_ARM_CLK>;
	};

	cpu@2 {
		compatible = "arm,cortex-a9";
		reg = <2>;
		next-level-cache = <&L2>;
		clocks = <&clock CLK_ARM_CLK>;
	};

	cpu@3 {
		compatible = "arm,cortex-a9";
		reg = <3>;
		next-level-cache = <&L2>;
		clocks = <&clock CLK_ARM_CLK>;
	};
};


2. All CPUs inside a cluster share clock/voltages, there are multiple clusters.

cpus {
	#address-cells = <1>;
	#size-cells = <0>;

	cpu@0 {
		compatible = "arm,cortex-a15";
		reg = <0>;
		next-level-cache = <&L2>;
		operating-points = <
			/* kHz    uV */
			792000  1100000
			396000  950000
			198000  850000
		>;
		clocks = <&clock CLK_ARM1_CLK>;
		clock-names = "cpu";
		clock-latency = <61036>; /* two CLK32 periods */
	};

	cpu@1 {
		compatible = "arm,cortex-a15";
		reg = <1>;
		next-level-cache = <&L2>;
		clocks = <&clock CLK_ARM1_CLK>;
	};

	cpu@100 {
		compatible = "arm,cortex-a7";
		reg = <100>;
		next-level-cache = <&L2>;
		operating-points = <
			/* kHz    uV */
			792000  950000
			396000  750000
			198000  450000
		>;
		clocks = <&clock CLK_ARM2_CLK>;
		clock-names = "cpu";
		clock-latency = <61036>; /* two CLK32 periods */
	};

	cpu@101 {
		compatible = "arm,cortex-a7";
		reg = <101>;
		next-level-cache = <&L2>;
		clocks = <&clock CLK_ARM2_CLK>;
	};
};
```

## Documentation/devicetree/bindings/rtc/armada-380-rtc.txt
```
* Real Time Clock of te Armada 38x SoCs

RTC controller for the Armada 38x SoCs

Required properties:
- compatible : Should be "marvell,armada-380-rtc"
- reg: physical base address of the controller and length of memory mapped
  region. The second entires is for the IP configuration part.
- interrupts: IRQ line for the RTC.

Example:

rtc@184a8 {
	compatible = "marvell,armada-380-rtc";
	reg = <0xa3800 0x20>, <0x184a0 0x0c>;
	interrupts = <GIC_SPI 21 IRQ_TYPE_LEVEL_HIGH>;
};
```
